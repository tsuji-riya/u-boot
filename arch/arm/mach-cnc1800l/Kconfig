## arch/arm/mach-cnc1800l/Kconfig
```kconfig
if ARCH_CNC1800L

config TARGET_CNC1800L
	bool "Cavium CNC1800L board"
	help
	  Support for Cavium CNC1800L based boards.
	  The CNC1800L SoC features an ARM1176JZF-S core
	  with NAND flash, USB, UART, and various peripherals.

source "board/cavium/cnc1800l/Kconfig"

endif
```

## arch/arm/mach-rockchip/rk322x/Kconfig
```kconfig
if ROCKCHIP_RK322X


config TARGET_EVB_RK3229
	bool "EVB_RK3229"
	select BOARD_LATE_INIT

config TARGET_MX10_RK3229
	bool "MX10 RK3229 TV box"
	select BOARD_LATE_INIT
	help
	  RK3229 "MX10" style Android TV box (1 GiB DDR3, 8 GiB eMMC).
	  This U-Boot is started by the original Rockchip loader (vendor
	  idblock + trust/TOS) from the "uboot" partition.

config TARGET_RK322X_BOX
	bool "RK322X-BOX"
	select BOARD_LATE_INIT
	help
	  Generic RK322x TV box, booted through the TPL/SPL chain with the
	  Rockchip DDR blob and OP-TEE.

config ROCKCHIP_BOOT_MODE_REG
	default 0x110005c8

config ROCKCHIP_STIMER_BASE
	default 0x110d0020

config SYS_SOC
	default "rk322x"

config SYS_MALLOC_F_LEN
	default 0x800

config SPL_LIBCOMMON_SUPPORT
	default y

config SPL_LIBGENERIC_SUPPORT
	default y

config SPL_SERIAL
	default y

config TPL_STACK
        default 0x10088000

config TPL_TEXT_BASE
        default 0x10081000

source "board/rockchip/evb_rk3229/Kconfig"
source "board/rockchip/mx10_rk3229/Kconfig"
source "board/rockchip/rk322x-box/Kconfig"

endif
```

## board/cavium/cnc1800l/Kconfig
```kconfig
if TARGET_CNC1800L

config SYS_BOARD
	default "cnc1800l"

config SYS_VENDOR
	default "cavium"

config SYS_SOC
	default "cnc1800l"

config SYS_CONFIG_NAME
	default "cnc1800l"

endif
```

## board/rockchip/mx10_rk3229/Kconfig
```kconfig
if TARGET_MX10_RK3229

config SYS_BOARD
	default "mx10_rk3229"

config SYS_VENDOR
	default "rockchip"

config SYS_CONFIG_NAME
	default "mx10_rk3229"

endif
```

## board/rockchip/rk322x-box/Kconfig
```kconfig
if TARGET_RK322X_BOX

config SYS_BOARD
	default "rk322x-box"

config SYS_VENDOR
	default "rockchip"

config SYS_CONFIG_NAME
	default "rk322x-box"

config BOARD_SPECIFIC_OPTIONS # dummy
	def_bool y

endif
```

## configs/cnc1800l_defconfig
```kconfig
CONFIG_ARM=y
CONFIG_SKIP_LOWLEVEL_INIT=y
CONFIG_SYS_ARM_CACHE_WRITETHROUGH=y
CONFIG_ARCH_CNC1800L=y
CONFIG_TEXT_BASE=0x02000000
CONFIG_SYS_MALLOC_LEN=0xC10000
CONFIG_TARGET_CNC1800L=y
CONFIG_NR_DRAM_BANKS=1
CONFIG_HAS_CUSTOM_SYS_INIT_SP_ADDR=y
CONFIG_CUSTOM_SYS_INIT_SP_ADDR=0x01400000
CONFIG_ENV_SIZE=0x10000
CONFIG_DEFAULT_DEVICE_TREE="cnc1800l"
CONFIG_SYS_LOAD_ADDR=0x800000
# CONFIG_SYS_MALLOC_CLEAR_ON_INIT is not set
CONFIG_BOOTDELAY=3
CONFIG_SYS_CBSIZE=256
CONFIG_SYS_PBSIZE=512
CONFIG_HUSH_PARSER=y
CONFIG_SYS_PROMPT="CNC1800L> "
# CONFIG_CMD_NET is not set
CONFIG_CMD_CACHE=y
CONFIG_DOS_PARTITION=y
CONFIG_OF_EMBED=y
CONFIG_ENV_OVERWRITE=y
# CONFIG_API is not set
```
